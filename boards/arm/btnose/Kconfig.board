## boards/arm/btnose/btnose_defconfig
```kconfig
CONFIG_SOC_NRF52805_CAAA=y
CONFIG_SOC_SERIES_NRF52X=y
CONFIG_CLOCK_CONTROL_NRF_K32SRC_XTAL=y
CONFIG_CLOCK_CONTROL_NRF_K32SRC_RC=n


# Enable MPU
CONFIG_ARM_MPU=y

# Enable RTT
CONFIG_USE_SEGGER_RTT=y

# enable GPIO
CONFIG_GPIO=y

# enable uart driver
CONFIG_SERIAL=y
CONFIG_UART_NRFX=y

# enable console
CONFIG_CONSOLE=y
CONFIG_UART_CONSOLE=y
CONFIG_RTT_CONSOLE=y

# additional board options
CONFIG_GPIO_AS_PINRESET=y 
```

## zephyr/boards/arm/btnose/Kconfig.defconfig
```kconfig
# Kconfig - btnose board configuration
#

if BOARD_BTNOSE

config BOARD
	default "btnose"

if I2C

config I2C_0
	default y

endif # I2C

config BT_CTLR
	default BT

endif # BOARD_BTNOSE
```
